## firmware/sdkconfig.defaults
```kconfig
# Rust often needs a bit of an extra main task stack size compared to C (the default is 3K)
CONFIG_ESP_MAIN_TASK_STACK_SIZE=17000

# Use this to set FreeRTOS kernel tick frequency to 1000 Hz (100 Hz by default).
# This allows to use 1 ms granuality for thread sleeps (10 ms by default).
# CONFIG_FREERTOS_HZ=1000

# Wifi tweak
CONFIG_ESP32_WIFI_NVS_ENABLED=y

## Power save configs
## Ref: https://github.com/espressif/esp-idf/blob/master/examples/wifi/power_save/sdkconfig.defaults
# Enable support for power management
CONFIG_PM_ENABLE=y
# Set CPU clock to 80MHz (160MHz default)
CONFIG_ESP_DEFAULT_CPU_FREQ_MHZ_80=y
CONFIG_ESP_DEFAULT_CPU_FREQ_MHZ=80
# Disable all GPIO at light sleep
# CONFIG_PM_SLP_DISABLE_GPIO=y
# CONFIG_PM_POWER_DOWN_PERIPHERAL_IN_LIGHT_SLEEP=y
# CONFIG_PM_POWER_DOWN_CPU_IN_LIGHT_SLEEP=y
# Enable tickless idle mode (automatic light sleep)
# CONFIG_FREERTOS_USE_TICKLESS_IDLE=n
CONFIG_BOOTLOADER_LOG_LEVEL=BOOTLOADER_LOG_LEVEL_ERROR
```
